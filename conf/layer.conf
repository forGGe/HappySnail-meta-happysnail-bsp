## conf/layer.conf
```bitbake
# We have a conf and classes directory, add to BBPATH
BBPATH .= ":${LAYERDIR}"

# We have recipes-* directories, add to BBFILES
BBFILES += "${LAYERDIR}/recipes-*/*/*.bb \
            ${LAYERDIR}/recipes-*/*/*.bbappend"

BBFILE_COLLECTIONS += "meta-happysnail-bsp"
BBFILE_PATTERN_meta-happysnail-bsp = "^${LAYERDIR}/"
BBFILE_PRIORITY_meta-happysnail-bsp = "6"

LAYERDEPENDS_meta-happysnail-bsp = "meta-sunxi"
LAYERSERIES_COMPAT_meta-happysnail-bsp = "warrior"

PACKAGE_CLASSES += "package_ipk"
MACHINE_ESSENTIAL_EXTRA_RRECOMMENDS += "kernel-modules"
```

## conf/machine/orange-pi-zero-hs.conf
```bitbake
#@TYPE: Machine
#@NAME: orange-pi-zero-custom
#@DESCRIPTION: Machine configuration for the orange-pi-zero, base on allwinner H2+ CPU

require conf/machine/include/sun8i.inc

PREFERRED_VERSION_u-boot = "v2018.09%"

KERNEL_DEVICETREE = "hs-bsp-tree.dtb"
UBOOT_MACHINE = "orangepi_zero_defconfig"

PREFERRED_VERSION_linux-mainline = "5.2.5"
```
